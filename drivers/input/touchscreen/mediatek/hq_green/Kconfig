## drivers/input/touchscreen/mediatek/hq_green/Kconfig
```kconfig
config TOUCHSCREEN_MTK_HIMAX_CHIPSET_SPI
	bool "Himax SPI support"
	default n
	help
	  Say Y here if you have NT36xxx touch panel.

	  If unsure, say N.

	  To compile this dirver as a module, choose M here: the
	  module will be called.

config TOUCHSCREEN_MTK_NT36xxx_HOSTDL_SPI
	bool "Himax SPI support"
	default n
	help
	  Say Y here if you have NT36xxx touch panel.

	  If unsure, say N.

	  To compile this dirver as a module, choose M here: the
	  module will be called.
 
#if TOUCHSCREEN_MTK_HIMAX_CHIPSET_SPI
source "drivers/input/touchscreen/mediatek/hq_green/hxchipset/Kconfig"
#endif
 
#if TOUCHSCREEN_MTK_NT36xxx_HOSTDL_SPI
source "drivers/input/touchscreen/mediatek/hq_green/nvt_driver/Kconfig"
#endif

# ifdef ODM_HQ_EDIT
# liunianliang@ODM.BSP.TP 2020/02/17, Add for oppo6771 Tp driver.
config TOUCHSCREEN_ILI9881H
	bool "ILI9881H support"
	default n
	help
	  Say Y here if you have ILI9881H touch panel.

	  If unsure, say N.

	  To compile this dirver as a module, choose M here: the
	  module will be called.

config TOUCHSCREEN_NT36525
	bool "NT36xxx SPI support"
	default n
	help
	  Say Y here if you have NT36xxx touch panel.

	  If unsure, say N.

	  To compile this dirver as a module, choose M here: the
	  module will be called.

#if TOUCHSCREEN_ILI9881H
source "drivers/input/touchscreen/mediatek/hq_green/ipio_touch_driver-v1.0.3.8/Kconfig"
#endif

#if TOUCHSCREEN_NT36525
source "drivers/input/touchscreen/mediatek/hq_green/nt36525/Kconfig"
#endif

#endif
```

## drivers/input/touchscreen/oppo_touchscreen/Novatek/Kconfig
```kconfig
source "drivers/input/touchscreen/oppo_touchscreen/Novatek/NT36672C_noflash/Kconfig"
source "drivers/input/touchscreen/oppo_touchscreen/Novatek/NT36525B_noflash/Kconfig"
```

## drivers/input/touchscreen/oppo_touchscreen/Novatek/NT36525B_noflash/Kconfig
```kconfig
config TOUCHPANEL_NOVA_NT36525B_NOFLASH
	default n
	bool "TP nova nt36525B IC enable or not for OPPO"
	---help---
	say Y to enable driver for Touchpanel useing nova nt36525B
```

## drivers/misc/mediatek/camera_ldo/Kconfig
```kconfig
config HQ_CAMERA_LDO
	bool CONFIG_HQ_CAMERA_LDO
	default n
	help
	  HQ CAMERA LDO driver
```

## drivers/misc/mediatek/nfc/Kconfig
```kconfig
##ifdef ODM_HQ_EDIT
## zuoqiquan@ODM.BSP.Sensor  2019/09/06 bring up nfc 

config NFC_CHIP_PN553
	tristate "NFC driver solution - NXP PN553 NFC Controller Driver"
	default n
	depends on I2C
	help
	  NXP PN553 Near Field Communication controller support.
	  If configures to be y, means devices supports NFC functionality.
	  If configures to be n, means devices doesn't support NFC functionality.

##endif /*ODM_HQ_EDIT*/
```

## drivers/power/Kconfig
```kconfig
source "drivers/power/avs/Kconfig"
source "drivers/power/reset/Kconfig"
source "drivers/power/supply/Kconfig"

#ifdef ODM_HQ_EDIT /* zhangchao@ODM.HQ.Charger 2019/09/4 modified for bring up charging */
#source "drivers/power/oppo/Kconfig"
config OPPO_HQ_CHARGER
	bool "OPPO_CHARGER"
	default n
	help
	  Set Yes to support OPPO_HQ_CHARGER features
	  smart battery.
	  Set No to disable OPPO_HQ_CHARGER features
	  smart battery.

config OPPO_HQ_EULER_CHARGER
	bool "OPPO_CHARGER"
	default n
	help
	  Set Yes to support OPPO_HQ_EULER_CHARGER features
	  smart battery.
	  Set No to disable OPPO_HQ_EULER_CHARGER features
	  smart battery.

config OPPO_CHARGER_MT6370_TYPEC
	bool "OPPO_CHARGER"
	default n
	help
	  Set Yes to support OPPO_CHARGER_MT6370_TYPEC features
	  smart battery.
	  Set No to disable OPPO_CHARGER_MT6370_TYPEC features
	  smart battery.

config OPPO_CHARGER
	bool "OPPO_CHARGER"
	default n
	help
	  Set Yes to support OPPO_CHARGER features
	  smart battery.
	  Set No to disable OPPO_CHARGER features
	  smart battery.

config OPPO_CHARGER_MTK
	bool "OPPO charger on MTK"
	default n
	help
	  Say Yes here to declare charging system is on MTK
	  Say No here to declare charging system is not on MTK

config OPPO_CHARGER_MTK_CHGIC
	bool "OPPO_CHARGER_MTK_CHG_IC"
	default n
	help
	  Say Yes to use MTK platform charger ic
	  Say No to use extern charger ic

config OPPO_CHARGER_MTK6779
	bool "OPPO_CHARGER_MTK6779"
	default n
	help
	  Set yes to support OPPO_CHARGER_MTK6779 features
	  smart battery.
	  Set No to disable OPPO_CHARGER_MTK6779 features
	  smart battery.

config OPPO_CHECK_CHARGERID_VOLT
	bool "OPPO_CHECK_CHARGERID_VOLT"
	default n
	help
	  Set yes to support OPPO_CHECK_CHARGERID_VOLT features
	  smart battery.
	  Set No to disable OPPO_CHECK_CHARGERID_VOLT features
	  smart battery.

config OPPO_4400MV_BATTERY_SUPPORT
	bool "OPPO_CHECK_CHARGERID_VOLT"
	default n
	help
	  Set yes to support BATTERYID features
	  smart battery.
	  Set No to disable BATTERYID features
	  smart battery.

config OPPO_CALL_MODE_SUPPORT
	bool "OPPO call mode support"
	default n
	help
	  Say Y to enable support for the oppo call mode.

config OPPO_SHIP_MODE_SUPPORT
	bool "OPPO ship mode support"
	default n
	help
	  Say Y to include support

config OPPO_SHORT_HW_CHECK
	bool "OPPO batt HW SHORT"
	default n
	help
	  Say Y to include support
#endif /* ODM_HQ_EDIT */
```
